// SPDX-License-Identifier: (GPL-2.0 OR MIT)
/*
 * Factory layout for the MT7996 tri-band radio.
 */

#include "mt798x-smartrg-factory.dtsi"

&factory_layout {
	/* mt7996 precal data size */
	precal_factory_1e10: precal@1e10 {
		reg = <0x1e10 0xee834>;
	};
};
