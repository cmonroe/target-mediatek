// SPDX-License-Identifier: (GPL-2.0 OR MIT)
/*
 * Copyright (C) 2025 SmartRG Inc.
 * Author: Chad Monroe <chad.monroe@smartrg.com>
 */

#include "mt7988a-smartrg-SDG-8713.dtsi"
#include "mt7988a-smartrg-mt-stuart-voice.dtsi"
#include "mt7988a-smartrg-SDG-8713-power-limits-r0-RCM-AU-NZ.dtsi"
#include "mt7988a-smartrg-SDG-8713-power-limits-r1-IC-CA.dtsi"
#include "mt7988a-smartrg-SDG-8713-power-limits-r2-ETSI-GB.dtsi"
#include "mt7988a-smartrg-SDG-8713-power-limits-r3-ETSI.dtsi"
#include "mt7988a-smartrg-SDG-8713-power-limits-r4-FCC-US.dtsi"

/ {
	model = "SmartRG SDG-8713v";
	compatible = "smartrg,sdg-8713v", "mediatek,mt7988a";
};
