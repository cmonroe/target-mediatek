## mediatek/files/drivers/net/dsa/mxl862xx/Kconfig
```kconfig
# SPDX-License-Identifier: GPL-2.0-only
config NET_DSA_MXL862
	tristate "MaxLinear MxL862xx"
	depends on NET_DSA
	select NET_DSA_TAG_MXL862
	help
	  This enables support for the MaxLinear MxL862xx switch family.

config NET_DSA_MXL862_IOCTL
	bool "Support IOCTL"
	depends on NET_DSA_MXL862
	help
	  This enables support for IOCTL for user space application quick
	  access.

config NET_DSA_MXL862_SYSFS
	bool "Support SYSFS for scripting"
	depends on NET_DSA_MXL862
	help
	  This enables support for sysfs for direct command from user space.
```
