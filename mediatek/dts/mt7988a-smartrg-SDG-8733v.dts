// SPDX-License-Identifier: (GPL-2.0 OR MIT)
/*
 * Copyright (C) 2023 SmartRG Inc.
 * Author: Chad Monroe <chad.monroe@smartrg.com>
 */

#include "mt7988a-smartrg-SDG-8733.dtsi"
#include "mt7988a-smartrg-mt-stuart-voice.dtsi"
#include "mt7988a-smartrg-mt-stuart-power-limits-r1-RCM-AU-NZ.dtsi"
#include "mt7988a-smartrg-mt-stuart-power-limits-r2-IC-CA.dtsi"
#include "mt7988a-smartrg-mt-stuart-power-limits-r3-ETSI-GB.dtsi"
#include "mt7988a-smartrg-mt-stuart-power-limits-r4-ETSI.dtsi"
#include "mt7988a-smartrg-mt-stuart-power-limits-r5-FCC-US.dtsi"

/ {
	model = "SmartRG SDG-8733v";
	compatible = "smartrg,sdg-8733v", "mediatek,mt7988a";
};
