// SPDX-License-Identifier: (GPL-2.0 OR MIT)
/*
 * Copyright (C) 2024 SmartRG Inc.
 * Author: Chad Monroe <chad.monroe@smartrg.com>
 */

#include "mt7988d-smartrg-mt-stuart-phase2b.dtsi"
#include "mt7988-smartrg-wifi-pcie3.dtsi"
#include "mt7988d-smartrg-SDG-9732i-power-limits-r1-RCM-AU-NZ.dtsi"
#include "mt7988d-smartrg-SDG-9732i-power-limits-r2-IC-CA.dtsi"
#include "mt7988d-smartrg-SDG-9732i-power-limits-r3-ETSI-GB.dtsi"
#include "mt7988d-smartrg-SDG-9732i-power-limits-r4-ETSI.dtsi"
#include "mt7988d-smartrg-SDG-9732i-power-limits-r5-FCC-US.dtsi"

/ {
	model = "SmartRG SDG-9732i";
	compatible = "smartrg,sdg-9732i", "mediatek,mt7988d";
};

/* MT7995 tri band radio: main function on pcie0, second on pcie3 */
&radio0 {
	ieee80211-freq-limit = <2400000 2500000>, <5170000 5835000>, <5945000 7125000>;

	band@2 {
		/* 6 GHz */
		reg = <2>;
		nvmem-cells = <&macaddr 0x6>;
		nvmem-cell-names = "mac-address";
	};
};
