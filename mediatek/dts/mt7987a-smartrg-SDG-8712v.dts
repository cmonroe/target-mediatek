// SPDX-License-Identifier: (GPL-2.0 OR MIT)
/*
 * Copyright (C) 2025 SmartRG Inc.
 * Author: Chad Monroe <chad.monroe@smartrg.com>
 */

#include "mt7987a-smartrg-mt-rainier.dtsi"
#include "mt7987a-smartrg-mt-rainier-voice.dtsi"

/ {
	model = "SmartRG SDG-8712v";
	compatible = "smartrg,sdg-8712v", "mediatek,mt7987a";
};
