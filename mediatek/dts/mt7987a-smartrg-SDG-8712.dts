// SPDX-License-Identifier: (GPL-2.0 OR MIT)
/*
 * Copyright (C) 2025 SmartRG Inc.
 * Author: Chad Monroe <chad.monroe@smartrg.com>
 */

#include "mt7987a-smartrg-mt-rainier.dtsi"
#include "mt7987a-smartrg-SDG-8712-power-limits-r1-RCM-AU-NZ.dtsi"
#include "mt7987a-smartrg-SDG-8712-power-limits-r2-IC-CA.dtsi"
#include "mt7987a-smartrg-SDG-8712-power-limits-r3-ETSI-GB.dtsi"
#include "mt7987a-smartrg-SDG-8712-power-limits-r4-ETSI.dtsi"
#include "mt7987a-smartrg-SDG-8712-power-limits-r5-FCC-US.dtsi"

/ {
	model = "SmartRG SDG-8712";
	compatible = "smartrg,sdg-8712", "mediatek,mt7987a";
};

/* mt7992 precal data size */
&precal_factory_1e10 {
	reg = <0x1e10 0x8b038>;
};
