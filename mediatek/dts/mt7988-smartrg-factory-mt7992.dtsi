// SPDX-License-Identifier: (GPL-2.0 OR MIT)
/*
 * Factory layout for the MT7992 dual-band radio.
 */

#include "mt7988-smartrg-factory.dtsi"

&factory_layout {
	/* mt7992 precal data size */
	precal_factory_1e10: precal@1e10 {
		reg = <0x1e10 0x8b038>;
	};
};
